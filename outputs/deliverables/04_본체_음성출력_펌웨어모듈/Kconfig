## outputs/deliverables/04_본체_음성출력_펌웨어모듈/Kconfig
```kconfig
config AAC_AUDIO_ZEPHYR_HAL
	bool "AAC audio: use bundled Zephyr HAL port (I2S + SPI NOR + NVS)"
	default y
	select I2S
	select FLASH
	select FLASH_MAP
	select NVS
```
